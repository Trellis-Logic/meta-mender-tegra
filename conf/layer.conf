## conf/layer.conf
```bitbake
# We have a conf and classes directory, add to BBPATH
BBPATH .= ":${LAYERDIR}"
# We have recipes-* directories, add to BBFILES
BBFILES += "${LAYERDIR}/recipes-*/*/*.bb \
		${LAYERDIR}/recipes-*/*/*.bbappend"

BBFILE_COLLECTIONS += "meta-mender-tegra-layer"
BBFILE_PATTERN_meta-mender-tegra-layer = "^${LAYERDIR}/"
BBFILE_PRIORITY_meta-mender-tegra-layer = "10"
LAYERVERSION_meta-mender-tegra-layer = "1"
LAYERSERIES_COMPAT_meta-mender-tegra-layer = "sumo"
#LAYERDEPENDS_meta-mender-tegra-layer = ""
```
